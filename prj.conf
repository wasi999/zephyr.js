## prj.conf
```kconfig
CONFIG_CPLUSPLUS=y
CONFIG_STDOUT_CONSOLE=y
CONFIG_NEWLIB_LIBC=y
CONFIG_FLOAT=y
CONFIG_RING_BUFFER=y
CONFIG_MAIN_STACK_SIZE=4096
CONFIG_SPI_1=y
CONFIG_RAM_SIZE=64
CONFIG_ROM_SIZE=144
CONFIG_SS_RESET_VECTOR=0x40034000
```

## nucleo_l476rg.overlay
```dts
&flash0 { reg = <0x40010000 (144 * 1024)>; };
&flash1 { reg = <0x40030000 (144 * 1024)>; };
&sram0 { reg = <0xa8004000 (64 * 1024)>; };
```

## src/zjs_board.c
```c
// Copyright (c) 2017, Intel Corporation.

// C includes
#include <string.h>

// ZJS includes
#include "zjs_board.h"
#include "zjs_common.h"
#include "zjs_util.h"

// max length of a pass-through pin like GPIO_0.12
#define FULL_PIN_MAX_LEN 16

typedef u8_t pin_id_t;

typedef struct {
    u8_t device;
    u8_t zpin;
#if defined(CONFIG_BOARD_ARDUINO_101) || defined(ZJS_LINUX_BUILD)
    u8_t zpin_ss;
#endif
} pin_map_t;

// E.g. to map IO3-5 to pin entries 7-9, use:
//   prefix "IO", offset 3, start 7, end 9
typedef struct {
    const char *prefix;
    pin_id_t offset;
    pin_id_t start;
    pin_id_t end;
} prefix_range_t;

typedef struct {
    pin_id_t start;
    pin_id_t end;
} pin_range_t;

typedef struct {
    const char *name;
    pin_id_t id;
} extra_pin_t;

typedef struct {
    pin_id_t from;
    pin_id_t to;
} pin_remap_t;

#if defined(BUILD_MODULE_GPIO) || defined(BUILD_MODULE_PWM) || defined(BUILD_MODULE_AIO)

#if defined(CONFIG_BOARD_ARDUINO_101) || defined(ZJS_LINUX_BUILD)
// see also docs/arduino_101.md
#include "boards/arduino_101_board.h"
#elif CONFIG_BOARD_FRDM_K64F
// see also docs/frdm_k64f.md
#include "boards/frdm_k64f_board.h"
#elif CONFIG_BOARD_NUCLEO_L476RG
#include "boards/nucleo_l476rg_board.h"
#else
//
// Basic support for all other boards
//

// for boards without pin name support, use pass-through method
#define BASIC_BOARD_SUPPORT
#endif  // end of board support

typedef struct {
    const char *prefix;
    const pin_range_t *range;
} prefix_t;

static int split_pin_name(const char *name, char *prefix, int *number)
{
    // requires: name is a pin name from JavaScript; prefix is a buffer with
    //             at least NAMED_PIN_MAX_LEN bytes; number is a pointer to
    //             an int to receive numeric portion of pin name
    //  effects: if name is NAMED_PIN_MAX_LEN or longer, returns a
    //             FIND_PIN_INVALID; if name contains characters following
    //             digits, returns FIND_PIN_INVALID; otherwise, if there are
    //             no digits, copies name to prefix and sets number to -1; if
    //             there are digits, copies any alphabet prefix in name to
    //             prefix, then parses the numeric value into number; on
    //             success, returns 0
    ZJS_ASSERT(name, "name is NULL");

    if (strnlen(name, NAMED_PIN_MAX_LEN) == NAMED_PIN_MAX_LEN) {
        DBG_PRINT("pin name too long: '%s'\n", name);
        return FIND_PIN_INVALID;
    }

    // find where number starts
    int index = -1;
    for (int i = 0; name[i]; ++i) {
        if (name[i] >= '0' && name[i] <= '9') {
            index = i;
            break;
        }
    }

    long num = -1;
    if (index == -1) {
        // no numeric portion
        strcpy(prefix, name);
    }
    else {
        // at least one digit was found
        char *end;
        num = strtol(name + index, &end, 10);
        if (*end) {
            DBG_PRINT("invalid pin suffix: '%s'\n", end);
            return FIND_PIN_INVALID;
        }

        strncpy(prefix, name, index);
        prefix[index] = '\0';
    }

    *number = num;
    return 0;
}

static int find_pin_id(const char *name,
                       const prefix_range_t map[], int map_len,
                       const extra_pin_t extra[], int extra_len)
{
    // requires: name is a pin name from JavaScript; map is an array of
    //             prefixes with range and offset that map to pins; map_len is
    //             the number of entries in map; extra is an array of special
    //             pin numbers and pin ids; extra_len is the number of entries
    //             in extra
    //  effects: searches for a pin name matching name, which may have an alpha
    //             prefix and may have a numeric suffix, but at least one of the
    //             two; if the name is numeric only, uses the first prefix in
    //             map to validate the pin, otherwise one based on the prefix;
    //             returns the id (row) in map that matches, or <0 on error

    char prefix[NAMED_PIN_MAX_LEN];
    int number;
    int rval = split_pin_name(name, prefix, &number);
    if (rval < 0) {
        return rval;
    }

    int id = -1;
    if (number != -1 && map_len > 0) {
        // at least one digit was found
        if (prefix[0] == '\0') {
            // no prefix found; use default from first entry
            strcpy(prefix, map[0].prefix);
        }

        // prefix found, find match to determine range
        for (int i = 0; i < map_len; ++i) {
            if (strequal(prefix, map[i].prefix)) {
                // if number in range, use it
                int num = number - map[i].offset + map[i].start;
                if (num <= map[i].end) {
                    id = num;
                    break;
                }
            }
        }
    }

    if (id < 0) {
        // still not found, try extras
        for (int i = 0; i < extra_len; ++i) {
            if (strequal(name, extra[i].name)) {
                id = extra[i].id;
            }
        }
    }

    if (id < 0) {
        DBG_PRINT("pin not found: '%s'\n", name);
        return FIND_PIN_FAILURE;
    }

    return id;
}

// do not call this directly, use the macro below
static int find_named_pin_priv(const char *name,
                               const pin_map_t *pins, size_t pins_size,
                               const prefix_range_t *map, size_t map_size,
                               const extra_pin_t *extras, int extras_size,
                               const char *prefix, const char *convert,
                               char *device_name, int name_len)
{
    // requires: name is a pin name from JavaScript; pins is an array mapping
    //             pin id to device id / number; pins_size is the size in bytes
    //             of the array; extras is an array of other friendly pin names
    //             and the id in pins they correspond to; extras_size is the
    //             size in bytes of the array; prefix is the prefix to the
    //             device name, e.g. GPIO_ for GPIO_0 device; convert is a
    //             string mapping device ids to the character that follows the
    //             prefix for a specific device driver; device_name is a place
    //             to store the device driver name, name_len is the receiving
    //             buffer length
    //  effects: searches for a pin name matching name, which may have an alpha
    //             prefix and may have a numeric suffix, but at least one of the
    //             two; if the name is numeric only, uses the first prefix that
    //             occurs in map to validate the pin, otherwise one based on the
    //             prefix; when the pin is found, returns the right device name
    //             in device-name, and returns the correct Zephyr pin
    int map_len = map_size / sizeof(prefix_range_t);
    int extra_len = extras_size / sizeof(extra_pin_t);
    int id = find_pin_id(name, map, map_len, extras, extra_len);
    if (id < 0) {
        return id;
    }

    ZJS_ASSERT(id < pins_size / sizeof(pin_map_t), "pin id overflow");

    if (pins[id].zpin == 255) {
        // mode not supported
        DBG_PRINT("unsupported mode for id %d\n", id);
        return FIND_PIN_FAILURE;
    }

    // pin found, return results
    int written = snprintf(device_name, name_len, "%s%d", prefix,
                           pins[id].device);
    if (written >= name_len) {
        DBG_PRINT("couldn't find device '%s'\n", name);
        return FIND_DEVICE_FAILURE;
    }

    DBG_PRINT("returning a pin %d, %d\n", id, pins[id].zpin);
    return pins[id].zpin;
}

// call this instead of the above function, see above for arg descriptions
#define find_named_pin(name, pins, map, extras, prefix, convert,    \
                       device_name, name_len)                       \
    find_named_pin_priv(name, pins, sizeof(pins), map, sizeof(map), \
                        extras, sizeof(extras), prefix, convert,    \
                        device_name, name_len)

static int find_full_pin(const char *name, const char *pin,
                         char *device_name, int name_len)
{
    // requires: name is the name portion and pin the pin portion of a
    //             name.pin pass-through pin spec (e.g. GPIO_0.17)
    //  effects: on failure, returns a negative value; on success writes the
    //             specified device name to device_name returns unvalidated
    //             pin number
    char *end = NULL;
    long num = strtol(pin, &end, 10);
    if (*end) {
        return FIND_PIN_INVALID;
    }

    int written = snprintf(device_name, name_len, "%s", name);
    if (written >= name_len) {
        DBG_PRINT("couldn't find device '%s'\n", name);
        return FIND_DEVICE_FAILURE;
    }

    return num;
}

static jerry_value_t pin2string(jerry_value_t jspin, int *rval)
{
    // effects: sets rval to 0 on success, <0 otherwise
    *rval = 0;
    if (jerry_value_is_number(jspin)) {
        // no error is possible w/ number or string
        return jerry_value_to_string(jspin);
    }

    if (jerry_value_is_string(jspin)) {
        return jerry_acquire_value(jspin);
    }

    DBG_PRINT("pin value wrong type\n");
    *rval = FIND_PIN_INVALID;
    return ZJS_UNDEFINED;
}

static int find_pin(jerry_value_t jspin, char *pin_name,
                    char *device_name, int name_len)
{
    // requires: pin_name is an output buffer with at least FULL_PIN_MAX_LEN
    //             bytes, device_name is a buffer to receive driver name, and
    //             name_len is the length of that buffer
    //  effects: tries to resolve pin as a full pin name, like GPIO_0.15
    //           returns pin number if found; returns FIND_PIN_INVALID on
    //           error; returns FIND_PIN_FAILURE if it's not a full pin
    //           but rather a named pin and writes pin name to pin_name
    int rval;
    ZVAL pin = pin2string(jspin, &rval);
    if (rval < 0) {
        return rval;
    }

    jerry_size_t size = FULL_PIN_MAX_LEN;
    zjs_copy_jstring(pin, pin_name, &size);
    if (!size) {
        DBG_PRINT("pin name too long\n");
        return FIND_PIN_INVALID;
    }

    char *ptr = strchr(pin_name, '.');
    if (ptr) {
        // split the string into device and pin portions
        *ptr = '\0';
        return find_full_pin(pin_name, ptr + 1, device_name, name_len);
    }

    DBG_PRINT("pin '%s' is not a full pin\n", pin_name);
    return FIND_PIN_FAILURE;
}
#endif  // BUILD_MODULE_GPIO || BUILD_MODULE_PWM || BUILD_MODULE_AIO

#ifdef BUILD_MODULE_GPIO
int zjs_board_find_gpio(jerry_value_t jspin, char *device_name, int len)
{
    char name[FULL_PIN_MAX_LEN];
    int pin = find_pin(jspin, name, device_name, len);

#ifndef BASIC_BOARD_SUPPORT
    if (pin == FIND_PIN_FAILURE) {
        return find_named_pin(name, digital_pins, digital_map, digital_extras,
                              digital_prefix, digital_convert,
                              device_name, len);
    }

#endif
    DBG_PRINT("gpio device name: '%s'\n", device_name);
    return pin;
}
#endif

#ifdef BUILD_MODULE_AIO
int zjs_board_find_aio(jerry_value_t jspin, char *device_name, int len)
{
    char name[FULL_PIN_MAX_LEN];
    int pin = find_pin(jspin, name, device_name, len);

#ifndef BASIC_BOARD_SUPPORT
    if (pin == FIND_PIN_FAILURE) {
        pin = find_named_pin(name, analog_pins, analog_map, analog_extras,
                             analog_prefix, analog_convert, device_name, len);
    }
#endif
    DBG_PRINT("Returning pin %s:%d\n", device_name, pin);
    return pin;
}
#endif

#ifdef BUILD_MODULE_PWM
int zjs_board_find_pwm(jerry_value_t jspin, char *device_name, int len)
{
    char name[FULL_PIN_MAX_LEN];
    int pin = find_pin(jspin, name, device_name, len);

#ifndef BASIC_BOARD_SUPPORT
    if (pin == FIND_PIN_FAILURE) {
        pin = find_named_pin(name, pwm_pins, pwm_map, pwm_extras,
                             pwm_prefix, pwm_convert, device_name, len);
    }
#endif
    DBG_PRINT("pwm device name: '%s'\n", device_name);
    return pin;
}
#endif

// wrappers for unit tests
#ifdef ZJS_LINUX_BUILD
int wrap_split_pin_name(const char *name, char *prefix, int *number)
{
    return split_pin_name(name, prefix, number);
}
#endif

#ifdef CONFIG_BOARD_ARDUINO_101
#define BOARD_NAME "arduino_101"
#elif ZJS_LINUX_BUILD
#define BOARD_NAME "linux (partially simulating arduino_101)"
#elif CONFIG_BOARD_FRDM_K64F
#define BOARD_NAME "frdm_k64f"
#elif CONFIG_BOARD_NUCLEO_L476RG
#define BOARD_NAME "nucleo_l476rg"
#elif CONFIG_BOARD_NRF52_PCA10040
#define BOARD_NAME "nrf52_pca10040"
#elif CONFIG_BOARD_ARDUINO_DUE
#define BOARD_NAME "arduino_due"
#elif CONFIG_BOARD_NUCLEO_F411RE
#define BOARD_NAME "nucleo_f411re"
#elif CONFIG_BOARD_96B_CARBON
#define BOARD_NAME "96b_carbon"
#elif CONFIG_BOARD_OLIMEX_STM32_E407
#define BOARD_NAME "olimex_stm32_e407"
#elif CONFIG_BOARD_STM32F4_DISCO
#define BOARD_NAME "stm32f4_disco"
#else
#define BOARD_NAME "unknown"
#endif

static jerry_value_t zjs_board_init()
{
    // create board object
    jerry_value_t board_obj = zjs_create_object();
    zjs_obj_add_readonly_string(board_obj, "name", BOARD_NAME);
    zjs_obj_add_readonly_string(board_obj, "version", "0.1");

    return board_obj;
}

JERRYX_NATIVE_MODULE(board, zjs_board_init)
```

## src/zjs_gpio.c
```c
// Copyright (c) 2016-2018, Intel Corporation.

// enable to use function tracing for debug purposes
#if 1
#define USE_FTRACE
static char FTRACE_PREFIX[] = "gpio";
#endif

// C includes
#include <stdlib.h>
#include <string.h>

// Zephyr includes
#ifndef ZJS_LINUX_BUILD
#include <gpio.h>
#include <misc/util.h>
#include <zephyr.h>
#endif

// ZJS includes
#include "zjs_board.h"
#include "zjs_callbacks.h"
#include "zjs_common.h"
#include "zjs_util.h"

#ifdef ZJS_GPIO_MOCK
#include "zjs_gpio_mock.h"
#else
#define DEVICE struct device *
#define zjs_gpio_mock_pre_init()
#define zjs_gpio_mock_post_init(gpio_obj)
#define zjs_gpio_mock_cleanup()
#endif

static jerry_value_t gpio_pin_prototype = 0;

// Handle for GPIO input pins, passed around between ISR/C callbacks
typedef struct gpio_handle {
    struct gpio_callback callback;  // Callback structure for zephyr
    DEVICE port;                    // Pin's port
    u32_t pin;                      // Pin associated with this handle
    u32_t value;                    // Value of the pin
    zjs_callback_id callbackId;     // ID for the C callback
    jerry_value_t pin_obj;          // Pin object returned from open()
    u32_t last;
    u8_t edge_both;
    bool active_low;
    bool closed;
} gpio_handle_t;

static void zjs_gpio_close(gpio_handle_t *handle)
{
    FTRACE("handle = %p\n", handle);
    zjs_remove_callback(handle->callbackId);
    gpio_remove_callback(handle->port, &handle->callback);
    handle->closed = true;
}

static void zjs_gpio_free_cb(void *native)
{
    FTRACE("native = %p\n", native);
    gpio_handle_t *handle = (gpio_handle_t *)native;
    if (!handle->closed)
        zjs_gpio_close(handle);

    zjs_free(handle);
}

static const jerry_object_native_info_t gpio_type_info = {
    .free_cb = zjs_gpio_free_cb
};

// non-static so that mock can access it, meant to be private though
void gpio_internal_lookup_pin(const jerry_value_t pin_obj, DEVICE *port,
                              int *pin)
{
    FTRACE("pin_obj = %p, port = %p, pin = %p\n", (void *)pin_obj, port, pin);
    gpio_handle_t *handle;
    const jerry_object_native_info_t *tmp;
    jerry_get_object_native_pointer(pin_obj, (void **)&handle, &tmp);
    if (tmp == &gpio_type_info) {
        *port = handle->port;
        *pin = handle->pin;
    }
}

// C callback from task context in response to GPIO input interrupt
static void zjs_gpio_c_callback(void *h, const void *args)
{
    FTRACE("h = %p, args = %p\n", h, args);
    gpio_handle_t *handle = (gpio_handle_t *)h;
    if (handle->closed) {
        ERR_PRINT("unexpected callback after close\n");
        return;
    }
    ZVAL onchange_func = zjs_get_property(handle->pin_obj, "onchange");

    // If pin.onChange exists, call it
    if (jerry_value_is_function(onchange_func)) {
        ZVAL event = zjs_create_object();
        u32_t *the_args = (u32_t *)args;
        // Put the numeric GPIO trigger value in the object
        zjs_obj_add_number(event, "value", the_args[0]);

        // Call the JS callback
        jerry_call_function(onchange_func, ZJS_UNDEFINED, &event, 1);
    } else {
        DBG_PRINT(("onChange has not been registered\n"));
    }
}

// Callback when a GPIO input fires
// INTERRUPT SAFE FUNCTION: No JerryScript VM, allocs, or release prints!
static void zjs_gpio_zephyr_callback(DEVICE port, struct gpio_callback *cb,
                                     u32_t pins)
{
    FTRACE("port = %p, cb = %p, pins = %x\n", (void *)port, cb, pins);
    // Get our handle for this pin
    gpio_handle_t *handle = CONTAINER_OF(cb, gpio_handle_t, callback);
    // Read the value and save it in the handle
    gpio_pin_read(port, handle->pin, &handle->value);
    if ((handle->edge_both && handle->value != handle->last) ||
        !handle->edge_both) {
        u32_t args[] = { handle->value, pins };
        // Signal the C callback, where we call the JS callback
        zjs_signal_callback(handle->callbackId, args, sizeof(args));
        handle->last = handle->value;
    }
}

static ZJS_DECL_FUNC(zjs_gpio_pin_read)
{
    // requires: this is a GPIOPin object from zjs_gpio_open, takes no args
    //  effects: reads a logical value from the pin and returns it in ret_val_p
    ZJS_GET_HANDLE(this, gpio_handle_t, handle, gpio_type_info);

    if (handle->closed) {
        return zjs_error("pin closed");
    }

    u32_t value;
    int rval = gpio_pin_read(handle->port, handle->pin, &value);
    if (rval) {
        ERR_PRINT("PIN: #%d\n", (int)handle->pin);
        return zjs_error("read failed");
    }

    if (handle->active_low) {
        value = !value;
    }

    return jerry_create_number(value);
}

static ZJS_DECL_FUNC(zjs_gpio_pin_write)
{
    // requires: this is a GPIOPin object from zjs_gpio_open, takes one arg,
    //             the logical boolean value to set to the pin (true = active)
    //  effects: writes the logical value to the pin

    // args: pin value
    ZJS_VALIDATE_ARGS(Z_BOOL Z_NUMBER);

    ZJS_GET_HANDLE(this, gpio_handle_t, handle, gpio_type_info);
    if (handle->closed) {
        return zjs_error("pin closed");
    }

    u32_t value;
    // TODO: Remove this deprecated option eventually
    if (jerry_value_is_boolean(argv[0])) {
        ZJS_PRINT("Deprecated! gpio.write() no longer takes a boolean!\n");
        value = jerry_get_boolean_value(argv[0]) ? 1 : 0;
    } else {
        value = (u32_t)jerry_get_number_value(argv[0]);
    }

    if (handle->active_low) {
        value = !value;
    }

    int rval = gpio_pin_write(handle->port, handle->pin, value);
    if (rval) {
        ERR_PRINT("GPIO: #%d!\n", (int)handle->pin);
        return zjs_error("write failed");
    }

    return ZJS_UNDEFINED;
}

static ZJS_DECL_FUNC(zjs_gpio_pin_close)
{
    ZJS_GET_HANDLE(this, gpio_handle_t, handle, gpio_type_info);
    if (handle->closed)
        return zjs_error("already closed");

    zjs_gpio_close(handle);
    return ZJS_UNDEFINED;
}

enum {
    ZJS_DIR_INPUT,
    ZJS_DIR_OUTPUT
};

enum {
    ZJS_EDGE_NONE,
    ZJS_EDGE_RISING = GPIO_INT | GPIO_INT_EDGE | GPIO_INT_ACTIVE_HIGH,
    ZJS_EDGE_FALLING = GPIO_INT | GPIO_INT_EDGE | GPIO_INT_ACTIVE_LOW,
    ZJS_EDGE_BOTH = GPIO_INT | GPIO_INT_EDGE | GPIO_INT_DOUBLE_EDGE
};

enum {
    ZJS_PULL_NONE,
    ZJS_PULL_UP,
    ZJS_PULL_DOWN
};

static ZJS_DECL_FUNC(zjs_gpio_open)
{
    // args: initialization object or int/string pin number
    ZJS_VALIDATE_ARGS(Z_NUMBER Z_STRING Z_OBJECT);

    ZVAL_MUTABLE pin_str = 0;
    jerry_value_t pin_val = argv[0];
    jerry_value_t init = 0;

    if (jerry_value_is_object(argv[0])) {
        init = argv[0];
        pin_str = zjs_get_property(init, "pin");
        pin_val = pin_str;
    }

    char devname[20];
    int pin = zjs_board_find_gpio(pin_val, devname, 20);
    if (pin == FIND_PIN_INVALID) {
        return TYPE_ERROR("bad pin argument");
    } else if (pin == FIND_DEVICE_FAILURE) {
        return zjs_error("device not found");
    } else if (pin < 0) {
        return zjs_error("pin not found");
    }
    DEVICE gpiodev = device_get_binding(devname);
    if (!gpiodev) {
        return zjs_error("device not found");
    }

    // ignore mapping for now as we can do it automatically

    // set defaults
    bool active_low = false;
    int dir = ZJS_DIR_OUTPUT;
    int edge = ZJS_EDGE_NONE;
    int pull = ZJS_PULL_NONE;

    if (init) {
        // TODO: Remove warning eventually
        ZVAL dirprop = zjs_get_property(init, "direction");
        if (!jerry_value_is_undefined(dirprop)) {
            ZJS_PRINT("Deprecated! gpio.open() direction property is "
                      "now 'mode'\n");
        }

        // override defaults where specified
        ZJS_REQUIRE_BOOL_IF_PROP(init, "activeLow", &active_low);

        str2int_t mode_map[] = {
            { "in", ZJS_DIR_INPUT },
            { "out", ZJS_DIR_OUTPUT },
            { NULL, 0 }
        };
        ZJS_REQUIRE_STR_IF_PROP_MAP(init, "mode", mode_map, 10, &dir);

        str2int_t edge_map[] = {
            { "none", ZJS_EDGE_NONE },
            { "rising", ZJS_EDGE_RISING },
            { "falling", ZJS_EDGE_FALLING },
            { "any", ZJS_EDGE_BOTH },
            { NULL, 0 }
        };
        ZJS_REQUIRE_STR_IF_PROP_MAP(init, "edge", edge_map, 10, &edge);

        str2int_t pull_map[] = {
            { "none", ZJS_PULL_NONE },
            { "pullup", ZJS_PULL_UP },
            { "pulldown", ZJS_PULL_DOWN },
            { NULL, 0 }
        };
        ZJS_REQUIRE_STR_IF_PROP_MAP(init, "state", pull_map, 10, &pull);
    }

    int flags = 0;
    flags |= active_low ? GPIO_POL_INV : GPIO_POL_NORMAL;
    if (dir == ZJS_DIR_INPUT) {
        flags |= GPIO_DIR_IN | edge;
    } else {
        flags |= GPIO_DIR_OUT;
    }
    if (pull == ZJS_PULL_NONE) {
        flags |= GPIO_PUD_NORMAL;
    } else {
        flags |= (pull == ZJS_PULL_UP) ? GPIO_PUD_PULL_UP : GPIO_PUD_PULL_DOWN;
    }

    int rval = gpio_pin_configure(gpiodev, pin, flags);
    if (rval) {
        ERR_PRINT("GPIO: #%d (RVAL: %d)\n", (int)pin, rval);
        return zjs_error("pin configure failed");
    }

    // create the GPIOPin object
    ZVAL pin_obj = zjs_create_object();
    jerry_set_prototype(pin_obj, gpio_pin_prototype);

    gpio_handle_t *handle = zjs_malloc(sizeof(gpio_handle_t));
    if (!handle) {
        return zjs_error("out of memory");
    }
    memset(handle, 0, sizeof(gpio_handle_t));
    handle->pin = pin;
    handle->pin_obj = pin_obj;  // weak reference
    handle->port = gpiodev;
    handle->callbackId = -1;
    handle->active_low = active_low;

    // Set the native handle so we can free it when close() is called
    jerry_set_object_native_pointer(pin_obj, handle, &gpio_type_info);

    if (dir == ZJS_DIR_INPUT) {
        // Zephyr ISR callback init
        gpio_init_callback(&handle->callback, zjs_gpio_zephyr_callback,
                           BIT(pin));
        gpio_add_callback(gpiodev, &handle->callback);
        gpio_pin_enable_callback(gpiodev, pin);

        // Register a C callback (will be called after the ISR is called)
        handle->callbackId = zjs_add_c_callback(handle, zjs_gpio_c_callback);
        handle->edge_both = (edge == ZJS_EDGE_BOTH) ? 1 : 0;
    }

    return jerry_acquire_value(pin_obj);
}

static void zjs_gpio_cleanup(void *native)
{
    FTRACE("native = %p\n", native);
    zjs_gpio_mock_cleanup();
    jerry_release_value(gpio_pin_prototype);
    gpio_pin_prototype = 0;
}

static const jerry_object_native_info_t gpio_module_type_info = {
    .free_cb = zjs_gpio_cleanup
};

static jerry_value_t zjs_gpio_init()
{
    FTRACE("\n");
    zjs_gpio_mock_pre_init();

    // create GPIO pin prototype object
    zjs_native_func_t array[] = {
        { zjs_gpio_pin_read, "read" },
        { zjs_gpio_pin_write, "write" },
        { zjs_gpio_pin_close, "close" },
        { NULL, NULL }
    };
    gpio_pin_prototype = zjs_create_object();
    zjs_obj_add_functions(gpio_pin_prototype, array);

    // create GPIO object
    jerry_value_t gpio_api = zjs_create_object();
    zjs_obj_add_function(gpio_api, "open", zjs_gpio_open);

    // Set up cleanup function for when the object gets freed
    jerry_set_object_native_pointer(gpio_api, NULL, &gpio_module_type_info);

    zjs_gpio_mock_post_init(gpio_api);

    return gpio_api;
}

JERRYX_NATIVE_MODULE(gpio, zjs_gpio_init)
```

## src/zjs_pinmux_l476rg.c
```c
/*
 * Copyright (c) 2016 Open-RnD Sp. z o.o.
 * Copyright (c) 2016 BayLibre, SAS
 *
 * SPDX-License-Identifier: Apache-2.0
 */

#include <kernel.h>
#include <device.h>
#include <init.h>
#include <pinmux.h>
#include <pinmux/pinmux.h>
#include <sys_io.h>


#include <pinmux/stm32/pinmux_stm32.h>

/* pin assignments for NUCLEO-L476RG board */
static const struct pin_config pinconf[] = {
#ifdef CONFIG_UART_1
	{STM32_PIN_PA9,  STM32L4X_PINMUX_FUNC_PA9_USART1_TX},
	{STM32_PIN_PA10, STM32L4X_PINMUX_FUNC_PA10_USART1_RX},
#endif	/* CONFIG_UART_1 */
#ifdef CONFIG_UART_2
	{STM32_PIN_PA2, STM32L4X_PINMUX_FUNC_PA2_USART2_TX},
	{STM32_PIN_PA3, STM32L4X_PINMUX_FUNC_PA3_USART2_RX},
#endif	/* CONFIG_UART_2 */
#ifdef CONFIG_UART_3
	{STM32_PIN_PB10, STM32L4X_PINMUX_FUNC_PB10_USART3_TX},
	{STM32_PIN_PB11, STM32L4X_PINMUX_FUNC_PB11_USART3_RX},
#endif	/* CONFIG_UART_3 */
#ifdef CONFIG_I2C_1
	{STM32_PIN_PB8, STM32L4X_PINMUX_FUNC_PB8_I2C1_SCL},
	{STM32_PIN_PB9, STM32L4X_PINMUX_FUNC_PB9_I2C1_SDA},
#endif /* CONFIG_I2C_1 */
#ifdef CONFIG_I2C_3
	{STM32_PIN_PC0, STM32L4X_PINMUX_FUNC_PC0_I2C3_SCL},
	{STM32_PIN_PC1, STM32L4X_PINMUX_FUNC_PC1_I2C3_SDA},
#endif /* CONFIG_I2C_3 */
#ifdef CONFIG_PWM_STM32_2
	{STM32_PIN_PA0, STM32L4X_PINMUX_FUNC_PA0_PWM2_CH1},
#endif /* CONFIG_PWM_STM32_2 */
#ifdef CONFIG_SPI_1
	/* SPI1 on the Arduino connectors pins A2, D3, D12, D11 */
	{STM32_PIN_PA4, STM32L4X_PINMUX_FUNC_PA4_SPI1_NSS},
	/* SPI1_SCK should output on PA5, but is used for LD2 */
	{STM32_PIN_PB3, STM32L4X_PINMUX_FUNC_PB3_SPI1_SCK},
	{STM32_PIN_PA6, STM32L4X_PINMUX_FUNC_PA6_SPI1_MISO},
	{STM32_PIN_PA7, STM32L4X_PINMUX_FUNC_PA7_SPI1_MOSI},
#endif /* CONFIG_SPI_1 */
#ifdef CONFIG_SPI_2
	/* SPI2 on the ST Morpho Connector CN10 pins 16, 30, 28, 26*/
	{STM32_PIN_PB12, STM32L4X_PINMUX_FUNC_PB12_SPI2_NSS},
	{STM32_PIN_PB13, STM32L4X_PINMUX_FUNC_PB13_SPI2_SCK},
	{STM32_PIN_PB14, STM32L4X_PINMUX_FUNC_PB14_SPI2_MISO},
	{STM32_PIN_PB15, STM32L4X_PINMUX_FUNC_PB15_SPI2_MOSI},
#endif /* CONFIG_SPI_1 */
#ifdef CONFIG_SPI_3
	/* SPI3 on the ST Morpho Connector CN7 pins 17, 1, 2, 3*/
	{STM32_PIN_PA15, STM32L4X_PINMUX_FUNC_PA15_SPI3_NSS},
	{STM32_PIN_PC10, STM32L4X_PINMUX_FUNC_PC10_SPI3_SCK},
	{STM32_PIN_PC11, STM32L4X_PINMUX_FUNC_PC11_SPI3_MISO},
	{STM32_PIN_PC12, STM32L4X_PINMUX_FUNC_PC12_SPI3_MOSI},
#endif /* CONFIG_SPI_3 */
};

static int pinmux_stm32_init(struct device *port)
{
	ARG_UNUSED(port);

	stm32_setup_pins(pinconf, ARRAY_SIZE(pinconf));

	return 0;
}

SYS_INIT(pinmux_stm32_init, PRE_KERNEL_1,
	 CONFIG_PINMUX_STM32_DEVICE_INITIALIZATION_PRIORITY);
```
